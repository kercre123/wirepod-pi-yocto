## conf/bblayers.conf
```bitbake
# POKY_BBLAYERS_CONF_VERSION is increased each time build/conf/bblayers.conf
# changes incompatibly
POKY_BBLAYERS_CONF_VERSION = "2"

BBPATH = "${TOPDIR}"
BBFILES ?= ""

YOCTOROOT = "${@os.path.abspath(os.path.join("${TOPDIR}", os.pardir))}"

BBLAYERS ?= " \
  ${YOCTOROOT}/poky/meta \
  ${YOCTOROOT}/poky/meta-yocto-bsp \
  ${YOCTOROOT}/meta-raspberrypi \
  ${YOCTOROOT}/meta-wirepod \
  ${YOCTOROOT}/meta-openembedded/meta-oe \
  ${YOCTOROOT}/meta-openembedded/meta-python \
  ${YOCTOROOT}/meta-openembedded/meta-networking \
  "
```

## meta-wirepod/conf/layer.conf
```bitbake
# We have a conf and classes directory, add to BBPATH
BBPATH .= ":${LAYERDIR}"

# We have a recipes directory, add to BBFILES
#BBFILES += "${LAYERDIR}/recipes-*/*/*.bb ${LAYERDIR}/recipes-*/*/*.bbappend"

BBFILES += "${LAYERDIR}/recipes*/*/*.bb \
            ${LAYERDIR}/recipes*/*/*.bbappend"

BBFILE_COLLECTIONS += "wirepod"
BBFILE_PATTERN_wirepod := "^${LAYERDIR}/"
BBFILE_PRIORITY_wirepod = "7"

# Define the layer dependencies
LAYERDEPENDS_wirepod = "core"
LAYERSERIES_COMPAT_wirepod = "scarthgap"

# Add your custom image to the list of images
#IMAGE_CLASSES += "wirepod-image"
LICENSE_FLAGS_ACCEPTED += "synaptics-killswitch"
```
